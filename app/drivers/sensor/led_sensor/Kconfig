## app/drivers/sensor/led_sensor/Kconfig
```kconfig
config LED_SENSOR
bool "LED sensor driver"
depends on SENSOR
select GPIO
default y
help
  led-sensor driver that controls an on-board LED.
```

## l5-task1/boards/our_board/stm32f4_disco/board.yml
```yaml
board:
  name: our_board
  full_name: Our Board
  vendor: Hela
  socs:
    - name: stm32f407xx
```

## l5-task2/boards/my_board/board.yml
```yaml
board:
  name: my_board 
  full_name: STM32F4 Discovery
  vendor: st
  socs:
    - name: stm32f407xx
```
